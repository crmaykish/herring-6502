PROGRAM_RAM = $1000

; VIA0 Registers
VIA0_PORTB = $8100
VIA0_PORTA = $8101
VIA0_DDRB = $8102
VIA0_DDRA = $8103

VIA_OUTPUT = $FF
VIA_INPUT = $00

; ACIA0 Registers
ACIA0_DATA = $8000
ACIA0_STATUS = $8001
ACIA0_COMMAND = $8002
ACIA0_CONTROL = $8003

; ACIA1 Registers
ACIA1_DATA = $8200
ACIA1_STATUS = $8201
ACIA1_COMMAND = $8202
ACIA1_CONTROL = $8203

; ACIA Values
ACIA_READY_RX = $08
ACIA_READY_TX = $10

; Send a dummy value to the ACIA STATUS register to reset it
ACIA_RESET = $00
; RTS low, transmit interrupt disabled, receiver interrupt disabled, DTR low
ACIA_COMMAND_INIT = $0B 
; Baudrate 1/16 oscillator, 8 data bits, 1 stop bit
ACIA_CONTROL_BAUD_115200 = %00010000

; Special ASCII characters
ASCII_NEWLINE = $0A
ASCII_RETURN = $0D
ASCII_ZERO = $00

; LCD Display
LCD_COMMAND = $8500
LCD_DATA = $8501
LCD_8_BIT_MODE = %00111000
LCD_DISPLAY_ON = %00001110
LCD_CURSOR_SETTINGS = %00000110
LCD_CLEAR = %01
LCD_HOME = %10
LCD_BUSY = %10000000